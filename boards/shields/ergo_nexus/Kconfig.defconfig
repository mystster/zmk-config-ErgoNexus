## boards/shields/ergo_nexus/Kconfig.defconfig
```kconfig
if SHIELD_ERGO_NEXUS_LEFT

# Name must be less than 16 characters long!
config ZMK_KEYBOARD_NAME
    default "ErgoNexus"

config ZMK_SPLIT_ROLE_CENTRAL
    default y

endif

if SHIELD_ERGO_NEXUS_LEFT || SHIELD_ERGO_NEXUS_RIGHT

config ZMK_SPLIT
    default y

endif
```

## boards/shields/ergo_nexus/Kconfig.shield
```kconfig
config SHIELD_ERGO_NEXUS_LEFT
    def_bool $(shields_list_contains,ergo_nexus_left)

config SHIELD_ERGO_NEXUS_RIGHT
    def_bool $(shields_list_contains,ergo_nexus_right)
```
